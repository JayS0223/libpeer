## examples/esp32/main/Kconfig.projbuild
```kconfig
menu "ESP32 Hardware Configuration"

    choice ESP32_CAMERA_MODEL
        prompt "Camera model"
        default ESP32_EYE
        help
            Select the camera model to use.
        config ESP32_EYE
            bool "ESP32-EYE"
        config ESP32S3_EYE
            bool "ESP32S3-EYE"
        config ESP32_M5STACK_CAMERA_B
            bool "M5STACK-CAMERA-B"
        config ESP32S3_XIAO_SENSE
            bool "ESP32S3-XIAO-SENSE"
    endchoice

endmenu

menu "Signaling Configuration"

    config WHIP_URL
        string "WHIP URL"
        default ""
        help
            URL for WHIP Endpoint.

    config WHIP_PORT
        int "WHIP PORT"
        default 443
        help
            Port for WHIP Endpoint.

    config WHIP_BEARER_TOKEN
        string "WHIP Bearer Token"
        default ""
        help
            Bearer token used in HTTP Authorization header.

endmenu

menu "Audio Media HAL"

choice AUDIO_BOARD
    prompt "Audio hardware board"
    default ESP32_S3_KORVO_1_V4_0_BOARD
    help
        Select an audio board to use

config ESP32_KORVO_V1_1_BOARD
    bool "ESP32-Korvo"
    depends on IDF_TARGET_ESP32
config ESP32_S3_BOX_BOARD
    bool "ESP32-S3-Box"
    depends on IDF_TARGET_ESP32S3
config ESP32_S3_BOX_3_BOARD
    bool "ESP32-S3-Box-3"
    depends on IDF_TARGET_ESP32S3
config ESP32_S3_KORVO_1_V4_0_BOARD
    bool "ESP32-S3-Korvo-1"
    depends on IDF_TARGET_ESP32S3
config ESP32_S3_KORVO_2_V3_0_BOARD
    bool "ESP32-S3-Korvo-2"
    depends on IDF_TARGET_ESP32S3
config ESP32_S3_EYE_BOARD
    bool "ESP32-S3-EYE"
    depends on IDF_TARGET_ESP32S3
config ESP32_P4_FUNCTION_EV_BOARD
    bool "ESP32-P4-Function_Ev"
    depends on IDF_TARGET_ESP32P4
config ESP32S3_XIAO
    bool "ESP32-S3-XIAO"
endchoice

endmenu
```
